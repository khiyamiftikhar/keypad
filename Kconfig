## Kconfig
```kconfig
menu "Matrix Keypad"

config MATRIX_KEYPAD_MAX_KEYPADS
    int "Maximum keypad instances"
    default 1
    range 1 5
    help
        Maximum number of keypad objects that can be created.

config MATRIX_KEYPAD_MAX_SIMULTANEOUS_KEYS
    int "Maximum simultaneous keys"
    default 4
    range 1 10
    help
        Maximum number of key presses that can be detected at the same time.

config MATRIX_KEYPAD_MAX_ROWS
    int "Maximum rows"
    default 4
    range 1 8
    help
        Maximum rows supported by the keypad.

config MATRIX_KEYPAD_MAX_COLS
    int "Maximum columns"
    default 4
    range 1 8
    help
        Maximum columns supported by the keypad.

menu "Button Behaviour"

config MATRIX_KEYPAD_DEBOUNCE_MS
    int "Debounce duration (ms)"
    default 20
    range 20 50
    help
        Time the signal must remain stable before a press is confirmed.

config MATRIX_KEYPAD_LONG_PRESS_MS
    int "Long press duration (ms)"
    default 1000
    range 900 1100
    help
        Duration after which a key press is considered a long press.

config MATRIX_KEYPAD_REPEAT_PRESS_MS
    int "Repeat press interval (ms)"
    default 500
    range 400 600
    help
        After a long press, a new press event will be generated every
        repeat interval while the key remains pressed.

endmenu

endmenu
```

## components/timer_impl/Kconfig.projbuild
```kconfig
menu "Timer Component"

    config MAX_OBJECTS
        int "Maximum number of timer objects"
        default 5
        range 1 20
        help
            Defines the maximum number of timer objects that can be created.
            Increase this value if you need more timers, but it will consume
            more memory.
endmenu
```

## examples/simple/sdkconfig.defaults
```kconfig
CONFIG_MATRIX_KEYPAD_MAX_KEYPADS=1
CONFIG_MATRIX_KEYPAD_MAX_ROWS=4
CONFIG_MATRIX_KEYPAD_MAX_COLS=4
CONFIG_MATRIX_KEYPAD_MAX_SIMULTANEOUS_KEYS=5

CONFIG_MATRIX_KEYPAD_DEBOUNCE_MS=20
CONFIG_MATRIX_KEYPAD_LONG_PRESS_MS=1000
CONFIG_MATRIX_KEYPAD_REPEAT_PRESS_MS=500
```

## private/keypad-button/keypad-button/Kconfig.projbuild
```kconfig
menu "Keypad Button"
    config TOTAL_BUTTON_OBJECTS
        int "Total number of button objects"
        default 16
        range 16 32
        help
            Specifies the total number of button objects for the keypad.

    config DEBOUNCE_DURATION
        int "debouncing duration"
        default 20          #ms
        range 20 50
        help
            Debounce duration before entering in to pressed state

    config LONG_PRESS_DURATION
        int "long press duration"
        default 1000          #ms
        range 900 1100
        help
            If button kept press for this duration, it will be considered long press

    config REPEAT_PRESS_DURATION
        int "Repeat press duration"
        default 5000          #ms
        range 400 500
        help
            If button kept press after long press, after every repeat duration new press will be considered
endmenu
```

## private/pool_allocator/pool_alloc_queue_impl/Kconfig.projbuild
```kconfig
menu "Object Pool"
    
    config MAX_ELEMENTS
        int "Total objects in a pool"
        default 4
        range 16 32
        help
            Total number of objects in the pool

    config MAX_WAIT_TIME
        int "Wait time (ms)"
        default 3
        help
            Wait time for the reading and writing to the pool

    config MAX_POOLS
        int "Max Pools"
        default 2
        help
            Total pool queues  that can be created
    
endmenu
```

## test_app/main/Kconfig
```kconfig
menu "User Configuration String"
    config UNIT_TESTING
            #string "unit testing"
            bool
            default y
            
endmenu
```
